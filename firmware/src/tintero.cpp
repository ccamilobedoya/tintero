// Tintero client: HTTPS with a per-device certificate (see tintero.h).

#include "tintero.h"

#include <NetworkClientSecure.h>
#include <WiFi.h>
#include <esp_heap_caps.h>
#include <esp_task_wdt.h>

#include "health.h"

// Generated by `npm run pki -- firmware`; git ignores it. It defines TINTERO_HOST,
// TINTERO_DEVICE_ID, TINTERO_CA_PEM, TINTERO_DEVICE_CERT_PEM and TINTERO_DEVICE_KEY_PEM.
#include "tintero_certs.h"

namespace tintero {
namespace {

constexpr uint16_t PORT = 443;
constexpr unsigned long SOCKET_TIMEOUT_MS = 10000;  // opening and writing (never above 10 s)
constexpr unsigned long HANDSHAKE_TIMEOUT_S = 15;   // TLS handshake
constexpr size_t MIN_LARGEST_BLOCK = 45000;         // below this, TLS may not fit: restart

// Deadlines of an answer (R3): no byte for idleMs → stalled; totalMs → timeout.
constexpr uint32_t SMALL_IDLE_MS = 10000, SMALL_TOTAL_MS = 15000;
constexpr uint32_t IMAGE_IDLE_MS = 10000, IMAGE_TOTAL_MS = 30000;

constexpr char FIRMWARE[] = "esp32-0.2";
constexpr char PANEL[] = "w=800,h=480,dpi=124,depth=1";  // GDEY075T7

char view[17] = "";  // for the Tintero-View header

NetworkClientSecure tls;  // the encrypted connection

class DeviceClock : public http::Clock {
 public:
  uint32_t nowMs() override { return millis(); }
  void pause() override {
    esp_task_wdt_reset();  // waiting is not a hang: feed the watchdog
    delay(2);
  }
};

// The bytes of the TLS connection, without ever blocking: 0 if nothing arrived.
class TlsSource : public http::Source {
 public:
  bool any = false;  // at least one byte of the answer arrived
  int read(uint8_t *buf, size_t n) override {
    const int avail = tls.available();
    if (avail > 0) {
      const int got = tls.read(buf, n < static_cast<size_t>(avail) ? n : static_cast<size_t>(avail));
      if (got > 0) any = true;
      return got < 0 ? -1 : got;
    }
    return tls.connected() ? 0 : -1;
  }
};

const char *stepOf(const char *path) {
  if (strstr(path, "/image") != nullptr) return "image";
  if (strstr(path, "/zones") != nullptr) return "zones";
  if (strstr(path, "/actions") != nullptr) return "actions";
  if (strstr(path, "/log") != nullptr) return "log";
  return "index";
}

void printTlsError() {
  char text[120];
  const int code = tls.lastError(text, sizeof text);
  if (code != 0) Serial.printf("  TLS: error %d: %s\n", code, text);
}

bool writeAll(const uint8_t *data, size_t n) {
  while (n > 0) {
    const size_t w = tls.write(data, n);
    if (w == 0) return false;
    data += w;
    n -= w;
  }
  return true;
}

// Writes the request: line, protocol headers and, for a POST, the JSON body.
bool sendRequest(const char *method, const char *path, const uint8_t *body, size_t bodyLen) {
  char head[640];
  int n = snprintf(head, sizeof head,
                   "%s %s HTTP/1.1\r\nHost: %s\r\nAccept-Encoding: identity\r\n"
                   "Tintero-Protocol: 1\r\nTintero-Firmware: %s\r\nTintero-Power: usb\r\n"
                   "Tintero-Formats: pb1,raw1\r\nTintero-Panel: %s\r\nTintero-RSSI: %d\r\n",
                   method, path, TINTERO_HOST, FIRMWARE, PANEL, (int)WiFi.RSSI());
  if (n < 0 || static_cast<size_t>(n) >= sizeof head) return false;
  if (view[0] != '\0') n += snprintf(head + n, sizeof head - n, "Tintero-View: %s\r\n", view);
  if (body != nullptr) {
    n += snprintf(head + n, sizeof head - n,
                  "Content-Type: application/json\r\nContent-Length: %u\r\n", (unsigned)bodyLen);
  }
  if (n < 0 || static_cast<size_t>(n) + 3 > sizeof head) return false;
  n += snprintf(head + n, sizeof head - n, "\r\n");
  if (!writeAll(reinterpret_cast<const uint8_t *>(head), static_cast<size_t>(n))) return false;
  return body == nullptr || bodyLen == 0 || writeAll(body, bodyLen);
}

// `expected` is only for the failure note (the size the view promised; 0 if unknown).
Response request(const char *method, const char *path, const uint8_t *body, size_t bodyLen,
                 http::Sink &sink, const http::Limits &limits, uint32_t expected) {
  Response r;
  r.status = -1;
  const uint32_t t0 = millis();
  const char *step = stepOf(path);
  DeviceClock clock;
  http::Result result = {http::Outcome::Closed, 0, 0, 0, false};

  for (int attempt = 0; attempt < 2; attempt++) {
    esp_task_wdt_reset();
    const bool reused = tls.connected();
    if (!reused) {
      if (heap_caps_get_largest_free_block(MALLOC_CAP_8BIT) < MIN_LARGEST_BLOCK) {
        Serial.printf("Heap: largest block %u bytes, too small for TLS\n",
                      (unsigned)heap_caps_get_largest_free_block(MALLOC_CAP_8BIT));
        health::restartIfAllowed("heap");
      }
      tls.stop();
      // The host name also goes in the TLS handshake (SNI): it must be the same as
      // the one in the server certificate.
      if (!tls.connect(TINTERO_HOST, PORT)) {
        Serial.printf("%s %s: connection failed\n", method, path);
        printTlsError();
        tls.stop();
        result.outcome = http::Outcome::Closed;
        break;
      }
    }

    TlsSource source;
    if (sendRequest(method, path, body, bodyLen)) {
      result = http::readResponse(source, clock, limits, sink);
    } else {
      result = {http::Outcome::Closed, 0, 0, 0, false};
    }
    // A reused connection the other side had already closed: nothing came back
    // and nothing reached the sink, so try once more with a new connection.
    if (reused && attempt == 0 && result.outcome == http::Outcome::Closed && !source.any) {
      Serial.printf("%s %s: reused connection was closed, retrying\n", method, path);
      tls.stop();
      continue;
    }
    break;
  }

  r.outcome = result.outcome;
  r.length = result.bodyBytes;
  r.retryAfterS = result.retryAfterS;
  const uint32_t ms = millis() - t0;

  if (result.outcome == http::Outcome::Ok) {
    r.status = result.status;
    if (!result.reusable) tls.stop();  // anything but a clean answer: the next one opens anew
    Serial.printf("%s %s → %d, %u bytes, %lu ms\n", method, path, r.status, (unsigned)r.length,
                  (unsigned long)ms);
    return r;
  }

  r.tooLarge = result.outcome == http::Outcome::TooLarge;
  if (r.tooLarge) r.status = result.status;
  tls.stop();  // unread or half-read data left on the connection: it cannot be reused
  Serial.printf("%s %s: %s (status %d, %u bytes, %lu ms)\n", method, path,
                http::outcomeName(result.outcome), result.status, (unsigned)result.bodyBytes,
                (unsigned long)ms);
  health::noteFailure(step, result.outcome, static_cast<uint32_t>(result.bodyBytes), expected, ms);
  return r;
}

Response small(const char *method, const char *path, const uint8_t *body, size_t bodyLen,
               uint8_t *buf, size_t cap) {
  http::BufferSink sink(buf, cap);
  const http::Limits limits = {SMALL_IDLE_MS, SMALL_TOTAL_MS, cap};
  return request(method, path, body, bodyLen, sink, limits, 0);
}

}  // namespace

void begin() {
  tls.setCACert(TINTERO_CA_PEM);  // only this CA: not the public ones, not any other
  tls.setCertificate(TINTERO_DEVICE_CERT_PEM);
  tls.setPrivateKey(TINTERO_DEVICE_KEY_PEM);
  tls.setHandshakeTimeout(HANDSHAKE_TIMEOUT_S);
  tls.setTimeout(SOCKET_TIMEOUT_MS);  // connect and write; reads never block (see TlsSource)
}

const char *deviceId() { return TINTERO_DEVICE_ID; }

Response get(const char *path, uint8_t *buf, size_t cap) {
  return small("GET", path, nullptr, 0, buf, cap);
}

Response post(const char *path, const uint8_t *body, size_t bodyLen, uint8_t *buf, size_t cap) {
  return small("POST", path, body, bodyLen, buf, cap);
}

Response getInto(const char *path, http::Sink &sink, size_t maxBody) {
  const http::Limits limits = {IMAGE_IDLE_MS, IMAGE_TOTAL_MS, maxBody};
  return request("GET", path, nullptr, 0, sink, limits, static_cast<uint32_t>(maxBody));
}

void setView(const char *viewId) {
  strncpy(view, viewId, sizeof view - 1);
  view[sizeof view - 1] = '\0';
}

void end() { tls.stop(); }

}  // namespace tintero
